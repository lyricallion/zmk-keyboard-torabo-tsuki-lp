## boards/shields/torabo_tsuki_lp/Kconfig.defconfig
```kconfig
if SHIELD_TORABO_TSUKI_LP_LEFT || SHIELD_TORABO_TSUKI_LP_RIGHT

config ZMK_KEYBOARD_NAME
    default "torabo-tsuki"

config ZMK_SPLIT
    default y

config SPI
    default y

config INPUT
    default y

config ZMK_MOUSE
    default y 
endif
if ZMK_KEYBOARD_YOUR_KEYBOARD

config ZMK_POINTING
    default y

config IQS7211E
    default y
CONFIG_IQS7211E_TAP_EDGE_MARGIN_PERMILLE=80
CONFIG_IQS7211E_SCROLLER_HWHEEL_ZONE_MIN_PERMILLE=0
CONFIG_IQS7211E_SCROLLER_HWHEEL_ZONE_MAX_PERMILLE=150
CONFIG_IQS7211E_SCROLLER_HWHEEL_ZONE_FROM_BOTTOM=n
endif
```
